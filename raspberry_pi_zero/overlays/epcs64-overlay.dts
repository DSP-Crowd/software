// Overlay for altera serial configuration device EPCS64N
/dts-v1/;
/plugin/;

/ {
	compatible = "brcm,bcm2708";

	fragment@0 {
		target = <&spi0>;
		__overlay__ {
			/* needed to avoid dtc warning */
			#address-cells = <1>;
			#size-cells = <0>;

			status = "okay";

			spidev@1{
				status = "disabled";
			};

			flash0: epcs64@0{
				/* use compatible flash driver, see spi-nor.c:
				 * { "epcs64",           INFO(0, 0,  256 * 256,  32, 0) },
				 * { "m25p16-nonjedec",  INFO(0, 0,  64 * 1024,  32, 0) },
				 */
				compatible = "m25p16-nonjedec";
				reg = <1>; /* CE1 */
				spi-max-frequency = <12000000>;
				status = "okay";
			};
		};
	};

	__overrides__ {
		speed   = <&flash0>, "spi-max-frequency:0"; /* 32 bit integer parameter */
	};
};
